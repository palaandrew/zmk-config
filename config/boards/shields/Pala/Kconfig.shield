## config/boards/shields/Pala/Kconfig.shield
```kconfig
# Copyright (c) 2020 Pete Johanson
# SPDX-License-Identifier: MIT

config SHIELD_PALA_LEFT
	def_bool $(shields_list_contains,PALA_left)

config SHIELD_PALA_RIGHT
	def_bool $(shields_list_contains,PALA_right)
```
